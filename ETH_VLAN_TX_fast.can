/*@!Encoding:65001*/
variables {
  ethernetPacket txPacket;
  ethernetPacket txPackets[8];
  byte vlanTag[4] = {0x81, 0x00, 0x00, 0x64}; 
  byte payload[4] = {0x01, 0x02, 0x03, 0x04}; 
  msTimer sendTimer;
  int currentMessageIndex = 0;
  byte rxBuffer[1518];
  dword rxLength;
}

on preStart {
  write("Ethernet channel initialization...");
}

on start {
  int i;
  // 기본 이더넷 패킷 초기화
  txPacket.source = EthGetMacAddressAsNumber("20:00:00:00:00:01");
  txPacket.destination = EthGetMacAddressAsNumber("ff:00:00:ff:ff:ff");
  txPacket.type = 0x0a0b;
  txPacket.Byte(0) = 0xAA;
  txPacket.length = 100;

  // 모든 패킷을 한번에 초기화
  for(i = 0; i < 8; i++) {
    txPackets[i] = txPacket;
    txPackets[i].byte(0) = i;
    txPackets[i].byte(1) = 0xfe;
    txPackets[i].SetVlanId(i);
    txPackets[i].SetVlanPriority(0x3);
  }
  
  // Pri5 패킷 특수 설정
  txPackets[5].byte(1) = 0x55;
  txPackets[5].byte(2) = 0xfe;
  txPackets[5].SetVlanId(101);

  write("Ethernet packets initialized successfully.");
  
  // 초기 타이머 시작
  setTimer(sendTimer, 1);
}

on timer sendTimer {
  output(txPackets[currentMessageIndex]);
  currentMessageIndex = (currentMessageIndex + 1) % 8; // 0-7 사이에서 순환
  setTimer(sendTimer, 1);
}
